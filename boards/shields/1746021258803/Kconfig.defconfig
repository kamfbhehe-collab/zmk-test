## boards/shields/1746021258803/Kconfig.defconfig
```kconfig
if SHIELD_1746021258803_RIGHT

config ZMK_KEYBOARD_NAME
    default "1746021258803"

endif

if SHIELD_1746021258803_LEFT || SHIELD_1746021258803_RIGHT

config ZMK_SPLIT
    default y

endif
```

## boards/shields/1746021258803/Kconfig.shield
```kconfig
config SHIELD_1746021258803_LEFT
    def_bool $(shields_list_contains,1746021258803_left)
config SHIELD_1746021258803_RIGHT
    def_bool $(shields_list_contains,1746021258803_right)
```
